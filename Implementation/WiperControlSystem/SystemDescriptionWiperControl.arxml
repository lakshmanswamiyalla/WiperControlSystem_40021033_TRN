AUTOSAR XML (schema 00050)
package /ARRoot
  can cluster RainSensorCANCluster
    can physical channel RainSensorCanPhysicalChannel: comm-connectors=RainSensorCanCommunicationConnector
  ecu instance RainSensorECUInstance
    can communication controller RainSensorCanCommunicationController
    can communication connector RainSensorCanCommunicationConnector: comm-controller=RainSensorCanCommunicationController
  flat map RainSensorFlatMap: instances=flat-instance-descriptor=RainSensorSystem.RainSensorRead
  system RainSensorSystem
    system mapping RainsensorSystemMapping: swc-to-impl-mapping{component-implementation=RainSensorImp, component=RainSensorRootSwComposition.RainSensorSwComponentProto.RainSensorSwComponentProto}
      sw-mappings:
        swc to ecu mapping RainSensorSwcToECUMapping: component=RainSensorRootSwComposition.RainSensorSwComponentProto.RainSensorSwComponentProto, ecu-instance=RainSensorECUInstance
    root-software-compositions:
      root sw composition prototype RainSensorRootSwComposition: flat-map=RainSensorFlatMap, software-composition=RainSensorTopLevelComposition
  composition sw component type RainSensorTopLevelComposition
    component RainSensorSwComponentProto: type=WiperControllerSwType
    delegation sw connector RainSensorConnectorProto: outer-port=RainSensorRead
  can cluster RainWipeCanCluster
    can physical channel RainWipeCanPhysicalChannel: comm-connectors=RainWipeCanCommunicationConnector
  ecu instance RainWipeECUInstance
    can communication controller RainWipeCanCommunicationController
    can communication connector RainWipeCanCommunicationConnector: comm-controller=RainWipeCanCommunicationController
  flat map RainWipeFlatMap: instances=flat-instance-descriptor=SingleWipeSystem.SingleWipeKey
  system RainWipeSystem
    system mapping RainWipeSystemMapping: client-server-to-signal-mapping=communication-direction=OUT, swc-to-impl-mapping{component-implementation=RainWipeImp, component=RainWipeRootSwComposition.RainWipeSwComponentProto.RainWipeSwComponentProto}
      sw-mappings:
        swc to ecu mapping RainWipeSwToEcuMapping: ecu-instance=RainWipeECUInstance
    root-software-compositions:
      root sw composition prototype RainWipeRootSwComposition: flat-map=RainWipeFlatMap, software-composition=RainWipeTopLevelComposition
  composition sw component type RainWipeTopLevelComposition
    component RainWipeSwComponentProto: type=WiperControllerSwType
    delegation sw connector RainWipeConnectorProto: outer-port=RainWipekey
  can cluster RearWipeCanCluster
    can physical channel SingleWipeCanPhysicalChannel: comm-connectors=RearWipeCanCommunicationConnector
  ecu instance RearWipeEcuInstance
    can communication controller RearWipeCanCommunicationController
    can communication connector RearWipeCanCommunicationConnector: comm-controller=RearWipeCanCommunicationController
  flat map RearWipeFlatMap: instances=flat-instance-descriptor=RearWipeSystem.RearWipe
  system RearWipeSystem
    system mapping RearWipeSystemMapping: client-server-to-signal-mapping=communication-direction=OUT, swc-to-impl-mapping{component-implementation=RearWipeImp, component=RearWipeRootSwComposition.RearWipeSwComponentProto.RearWipeSwComponentProto}, swc-to-ecu-mapping{component=RearWipeRootSwComposition.RearWipeSwComponentProto.RearWipeSwComponentProto, ecu-instance=RearWipeEcuInstance}
    root-software-compositions:
      root sw composition prototype RearWipeRootSwComposition: flat-map=RearWipeFlatMap, software-composition=RearWipeTopLevelComposition
  composition sw component type RearWipeTopLevelComposition
    component RearWipeSwComponentProto: type=WiperControllerSwType
    delegation sw connector RearWipeConnectorProto: outer-port=RearWipe
  can cluster SingleWipeCanCluster
    can physical channel SingleWipeCanPhysicalChannel
  ecu instance SingleWipeEcuInstance
    can communication controller SingleWipeCanCommunicationController
    can communication connector SingleWipeCanCommunicationConnector: comm-controller=SingleWipeCanCommunicationController
  flat map SingleWipeFlatMap: instances=flat-instance-descriptor=SingleWipeSystem.SingleWipeKey
  system SingleWipeSystem
    system mapping SingleWipeSystemMapping: client-server-to-signal-mapping=communication-direction=OUT, swc-to-impl-mapping{component-implementation=SingleWipeImp, component=SingleWipeRootSwComposition.SingleWipeSwComponentProto.RainWipeSwComponentProto}, swc-to-ecu-mapping{component=SingleWipeRootSwComposition.SingleWipeSwComponentProto.SingleWipeSwComponentProto, ecu-instance=SingleWipeEcuInstance}
    root-software-compositions:
      root sw composition prototype SingleWipeRootSwComposition: flat-map=SingleWipeFlatMap, software-composition=SingleWipeTopLevelComposition
  composition sw component type SingleWipeTopLevelComposition
    component SingleWipeSwComponentProto: type=WiperControllerSwType
    delegation sw connector SingleWipeConnectorProto: outer-port=SingleWipeKey
  can cluster SpeedOfWiperCanCluster
    can physical channel SpeedOfWiperCanPhysicalChannel: comm-connectors=SpeedOfWiperCanCommunicationConnector
  ecu instance SpeedOfWiperEcuInstance
    can communication controller SpeedOfWiperCanCommunicationController
    can communication connector SpeedOfWiperCanCommunicationConnector: comm-controller=SpeedOfWiperCanCommunicationController
  flat map SpeedOfWiperFlatMap: instances=flat-instance-descriptor=SpeedOfWiperSystem.SpeedOfWiper
  system SpeedOfWiperSystem
    system mapping SpeedOfWiperSystemMapping: client-server-to-signal-mapping=communication-direction=OUT, swc-to-impl-mapping{component-implementation=SpeedOfWiperImp, component=SpeedOfWiperRootSwComposition.SpeedOfWiperSwComponentProto.SpeedOfWiperSwComponentProto}, swc-to-ecu-mapping{component=SpeedOfWiperRootSwComposition.SpeedOfWiperSwComponentProto.SpeedOfWiperSwComponentProto, ecu-instance=SpeedOfWiperEcuInstance}
    root-software-compositions:
      root sw composition prototype SpeedOfWiperRootSwComposition: flat-map=SpeedOfWiperFlatMap, software-composition=SpeedOfWiperTopLevelComposition
  composition sw component type SpeedOfWiperTopLevelComposition
    component SpeedOfWiperSwComponentProto: type=WiperControllerSwType
    delegation sw connector SpeedOfWiperConnectorProto: outer-port=SpeedOfWiper
  can cluster WashAndWipeCanCluster
    can physical channel SingleWipeCanPhysicalChannel: comm-connectors=WashAndWipeCanCommunicationConnector
  ecu instance WashAndWipeEcuInstance
    can communication controller WashAndWipeCanCommunicationController
    can communication connector WashAndWipeCanCommunicationConnector: comm-controller=WashAndWipeCanCommunicationController
  flat map WashAndWipeFlatMap: instances=flat-instance-descriptor=WashAndWipeSystem.WashAndWipe
  system WashAndWipeSystem
    system mapping WashAndWipeSystemMapping: client-server-to-signal-mapping=communication-direction=OUT, swc-to-impl-mapping{component-implementation=WashAndWipeImp, component=WashAndWipeRootSwComposition.WashAndWipeSwComponentProto.WashAndWipeSwComponentProto}, swc-to-ecu-mapping{component=WashAndWipeRootSwComposition.WashAndWipeSwComponentProto.WashAndWipeSwComponentProto, ecu-instance=WashAndWipeEcuInstance}
    root-software-compositions:
      root sw composition prototype WashAndWipeRootSwComposition: flat-map=WashAndWipeFlatMap, software-composition=WashAndWipeTopLevelComposition
  composition sw component type WashAndWipeTopLevelComposition
    component WashAndWipeSwComponentProto: type=WiperControllerSwType
    delegation sw connector WashAndWipeConnectorProto: outer-port=WashAndWipe
